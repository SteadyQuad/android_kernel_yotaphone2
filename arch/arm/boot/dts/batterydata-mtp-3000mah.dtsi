/* Copyright (c) 2013, The Linux Foundation. All rights reserved.
 *
 * This program is free software; you can redistribute it and/or modify
 * it under the terms of the GNU General Public License version 2 and
 * only version 2 as published by the Free Software Foundation.
 *
 * This program is distributed in the hope that it will be useful,
 * but WITHOUT ANY WARRANTY; without even the implied warranty of
 * MERCHANTABILITY or FITNESS FOR A PARTICULAR PURPOSE.  See the
 * GNU General Public License for more details.
 */

qcom,mtp-3000mah {
	qcom,fcc-mah = <2500>;
	qcom,default-rbatt-mohm = <150>;
	qcom,max-voltage-uv = <4350000>;
	qcom,rbatt-capacitive-mohm = <50>;
	qcom,v-cutoff-uv = <3400000>;
	qcom,chg-term-ua = <100000>;
	qcom,batt-id-kohm = <47>;

	qcom,fcc-temp-lut {
		qcom,lut-col-legend = <(-20) 0 25 40 60>;
		qcom,lut-data = <2486 2487 2489 2489 2484>;
	};

	qcom,pc-temp-ocv-lut {
		qcom,lut-col-legend = <(-20) 0 25 40 60>;
		qcom,lut-row-legend = <100 95 90 85 80>,
				<75 70 65 60 55>,
				<50 45 40 35 30>,
				<25 20 16 13 11>,
				<10 9 8 7 6>,
				<5 4 3 2 1>,
				<0>;
		qcom,lut-data = <4324 4322 4318 4312 4304>,
				<4222 4246 4249 4247 4243>,
				<4148 4187 4192 4191 4187>,
				<4084 4128 4138 4137 4133>,
				<4027 4068 4086 4086 4083>,
				<3965 4012 4038 4038 4035>,
				<3919 3960 3991 3993 3991>,
				<3879 3919 3940 3949 3948>,
				<3841 3882 3889 3891 3892>,
				<3807 3850 3855 3857 3857>,
				<3779 3822 3828 3830 3831>,
				<3756 3797 3805 3808 3809>,
				<3737 3776 3788 3789 3789>,
				<3719 3757 3771 3769 3759>,
				<3697 3734 3752 3746 3733>,
				<3670 3715 3723 3717 3703>,
				<3630 3702 3693 3686 3676>,
				<3580 3687 3684 3679 3668>,
				<3522 3661 3667 3657 3640>,
				<3465 3625 3630 3622 3603>,
				<3432 3598 3604 3598 3578>,
				<3392 3558 3574 3569 3550>,
				<3348 3510 3537 3536 3519>,
				<3304 3458 3496 3500 3489>,
				<3258 3404 3452 3464 3457>,
				<3217 3350 3405 3424 3418>,
				<3172 3299 3352 3374 3370>,
				<3129 3246 3293 3313 3310>,
				<3089 3184 3222 3236 3231>,
				<3054 3109 3131 3135 3125>,
				<3000 3000 3000 3000 3000>;
	};

	qcom,rbatt-sf-lut {
		qcom,lut-col-legend = <(-20) 0 25 40 60>;
		qcom,lut-row-legend = <100 95 90 85 80>,
				<75 70 65 60 55>,
				<50 45 40 35 30>,
				<25 20 16 13 11>,
				<10 9 8 7 6>,
				<5 4 3 2 1>;
		qcom,lut-data = <994 244 100 85 79>,
                               <952 252 104 87 81>,
                               <952 251 104 87 81>,
                               <910 250 108 89 82>,
                               <886 241 113 91 83>,
                               <869 236 120 94 85>,
                               <873 230 127 100 89>,
                               <878 231 120 108 94>,
                               <888 232 104 89 82>,
                               <900 235 102 87 81>,
                               <919 238 103 88 83>,
                               <946 242 105 92 86>,
                               <990 247 109 93 89>,
                               <1051 249 110 91 83>,
                               <1138 243 108 87 81>,
                               <1260 249 107 87 81>,
                               <1635 287 103 86 82>,
                               <2061 343 113 94 86>,
                               <2521 384 130 104 97>,
                               <2835 387 130 108 102>,
                               <2728 367 130 110 104>,
                               <2410 339 134 113 108>,
                               <3154 343 139 115 110>,
                               <4335 351 146 120 113>,
                               <5967 367 157 126 117>,
                               <8524 395 169 134 121>,
                               <12767 439 179 143 128>,
                               <20422 508 195 154 138>,
                               <31702 692 224 173 154>,
                               <44596 1388 329 240 211>;
	};
};
